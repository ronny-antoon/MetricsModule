## components/MetricsModule/Kconfig.projbuild
```kconfig
menu "Metrics Module"
    config M_M_ENABLED
        bool
        prompt "Enable Metrics Module"
        default y
        help
          Enable Metrics Module

    config M_M_PRINT_METRICS
        bool
        prompt "Print Metrics"
        default y
        help
          Print Metrics

    config M_M_SEND_METRICS_PERIOD
        int
        prompt "Send Metrics Period in seconds"
        default 15
        range 1 3600
        help
          Send Metrics Period in seconds

    config M_M_BUFFER_SIZE
        int
        prompt "Metrics Buffer Size"
        default 1024
        help
          Metrics Buffer Size

    config M_M_TASK_STACK_SIZE
        int
        prompt "Metrics Task Stack Size"
        default 4096
        help
          Metrics Task Stack Size

    config M_M_TASK_PRIORITY
        int
        prompt "Metrics Task Priority"
        default 10
        range 1 31
        help
          Metrics Task Priority

    config M_M_DEFAULT_DATABASE_URL
        string
        prompt "Default URL"
        default "http://meta.kiwiapps.org/metrics"
        help
          Default URL for the database without "/" at the end

    config M_M_DEFAULT_DEVICE_LOCATION
        string
        prompt "Default Device Location"
        default "defaultLocation"
        help
          Default Device Location

    config M_M_DEFAULT_TOKEN
        string
        prompt "Default Token"
        default "Ronny123!@#RRR"
        help
          Default Token

    config M_M_HTTP_TIMEOUT_MS
        int
        prompt "HTTP Timeout in ms"
        default 10000
        help
          HTTP Timeout in ms

    config M_M_PRINT_METRICS_BUFFER
        bool
        prompt "Print Metrics Buffer"
        default y
        help
          Print Metrics Buffer
endmenu
```

## sdkconfig.defaults
```kconfig
CONFIG_M_M_SEND_METRICS_PERIOD=10

# Default to 921600 baud when flashing and monitoring device
CONFIG_ESPTOOLPY_BAUD_921600B=y
CONFIG_ESPTOOLPY_BAUD=921600
CONFIG_ESPTOOLPY_COMPRESSED=y
CONFIG_ESPTOOLPY_MONITOR_BAUD_115200B=y
CONFIG_ESPTOOLPY_MONITOR_BAUD=115200
CONFIG_ESPTOOLPY_FLASHSIZE_4MB=y

# Use a custom partition table
CONFIG_PARTITION_TABLE_CUSTOM=y
CONFIG_PARTITION_TABLE_FILENAME="partitions.csv"
CONFIG_PARTITION_TABLE_OFFSET=0xC000
```
